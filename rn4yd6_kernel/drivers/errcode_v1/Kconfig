## rn4yd6_kernel/drivers/errcode_v1/Kconfig
```kconfig
menuconfig ERRCODE
        tristate "linux err_code"
        help
         this is simple errcode 

config  LINUX_ERR_CODE
        tristate "errcode For rn4y56"
        depends on ERRCODE
        help
         this is simple errcode
```

## rn4yd6_kernel/drivers/misc/fms6502/Kconfig
```kconfig
config MS_FMS6502_I2C
	tristate "FMS6502 i2c driver"
	default n
	help
	  Say Y here to include support for communicating with the data
	  processing of APPLE MFI.
```

## rn4yd6_kernel/drivers/misc/mfi_i2c/Kconfig
```kconfig
config MS_MFI_I2C
	tristate "Apple MFI i2c driver"
	default n
	help
	  Say Y here to include support for communicating with the data
	  processing of APPLE MFI.
```

## rn4yd6_kernel/drivers/rpmsg/Kconfig
```kconfig
menu "Rpmsg drivers"

# RPMSG always gets selected by whoever wants it
config RPMSG
	tristate
	select VIRTIO
	select VIRTUALIZATION

config RPMSG_CDEV
	tristate "Foryou RPMSG driver"
	depends on RPMSG
endmenu
```

## rn4yd6_kernel/drivers/uart_debug_drv/Kconfig
```kconfig
menuconfig UART_DEBUG
        tristate "uart debug communicate in kernel"
        help
         this is uart debug 

config  UART_DEBUG_INTERFACE
        tristate "uart debug interface for rn4yd6"
        depends on UART_DEBUG
        help
         this is UART_DEBUG_INTERFACE
```

## rn4yd6_kernel/drivers/usb_power_patch/Kconfig
```kconfig
menuconfig USB_PATCH
        tristate "usb_power_patch"
        help
         this is usb_power_patch 

config  USB_PWOER_PATCH
        tristate "patch For rn4y56"
        depends on USB_PATCH
        help
         this is USB_PATCH
```
